## CMakeLists.txt
```
cmake_minimum_required(VERSION 3.28.1)

option(USE_CH376S "Use CH376S (8-bit UART) instead of CH375 (9-bit UART)" ON)

# Device tree overlays
if(BOARD STREQUAL "stm32f4_disco")
    set(DTC_OVERLAY_FILE "${CMAKE_CURRENT_SOURCE_DIR}/boards/stm32f4_disco.overlay")
elseif(BOARD MATCHES "^rpi_pico2")
    set(DTC_OVERLAY_FILE "${CMAKE_CURRENT_SOURCE_DIR}/boards/rpi_pico2.overlay")
elseif(BOARD MATCHES "^rpi_pico$")
    set(DTC_OVERLAY_FILE "${CMAKE_CURRENT_SOURCE_DIR}/boards/rpi_pico.overlay")
endif()

find_package(Zephyr REQUIRED HINTS $ENV{ZEPHYR_BASE})
project(usb_hid_proxy)

# Common source files
target_sources(app PRIVATE
    ${CMAKE_CURRENT_SOURCE_DIR}/src/main.c
    ${CMAKE_CURRENT_SOURCE_DIR}/drivers/hid/src/hid_parser.c
    ${CMAKE_CURRENT_SOURCE_DIR}/drivers/hid/src/hid_mouse.c
    ${CMAKE_CURRENT_SOURCE_DIR}/drivers/hid/src/hid_keyboard.c
    ${CMAKE_CURRENT_SOURCE_DIR}/drivers/hid/src/hid_output.c
    ${CMAKE_CURRENT_SOURCE_DIR}/src/usb_hid_proxy.c
    ${CMAKE_CURRENT_SOURCE_DIR}/src/input_patterns.c
    # Common CH375 host layer (shared by both chips)
    ${CMAKE_CURRENT_SOURCE_DIR}/drivers/ch37x/src/ch375_host.c
)

# Chip-specific UART implementation
if(USE_CH376S)
    message(STATUS "========================================")
    message(STATUS "Building for CH376S (8-bit UART)")
    message(STATUS "========================================")
    
    # Define preprocessor macro
    target_compile_definitions(app PRIVATE USE_CH376S=1)
    
    # CH376S core files
    target_sources(app PRIVATE
        ${CMAKE_CURRENT_SOURCE_DIR}/drivers/ch37x/src/ch376s.c
        ${CMAKE_CURRENT_SOURCE_DIR}/drivers/ch37x/src/ch376s_uart.c
    )
    
    # CH376S only supports RP2040/RP2350
    if(CONFIG_SOC_RP2350A_M33 OR CONFIG_SOC_RP2040)
        target_sources(app PRIVATE
            ${CMAKE_CURRENT_SOURCE_DIR}/drivers/ch37x/src/ch376s_uart_rp2.c
        )
        
        # PIO support
        zephyr_library_include_directories(
            ${ZEPHYR_BASE}/../modules/hal/rpi_pico/src/rp2_common/hardware_pio/include
            ${ZEPHYR_BASE}/../modules/hal/rpi_pico/src/rp2_common/hardware_clocks/include
            ${ZEPHYR_BASE}/../modules/hal/rpi_pico/src/rp2_common/hardware_gpio/include
            ${ZEPHYR_BASE}/../modules/hal/rpi_pico/src/common/hardware_claim/include
            ${ZEPHYR_BASE}/../modules/hal/rpi_pico/src/rp2_common/pico_base/include
        )
        message(STATUS "Platform: ${BOARD} (CH376S with 8-bit PIO UART)")
    else()
        message(FATAL_ERROR "CH376S only supported on RP2040/RP2350 platforms!")
    endif()
    
else()
    message(STATUS "========================================")
    message(STATUS "Building for CH375 (9-bit UART)")
    message(STATUS "========================================")
    
    # CH375 core files
    target_sources(app PRIVATE
        ${CMAKE_CURRENT_SOURCE_DIR}/drivers/ch37x/src/ch375.c
        ${CMAKE_CURRENT_SOURCE_DIR}/drivers/ch37x/src/ch375_uart.c
    )
    
    # Platform-specific UART implementation
    if(CONFIG_SOC_SERIES_STM32F4X)
        target_sources(app PRIVATE
            ${CMAKE_CURRENT_SOURCE_DIR}/drivers/ch37x/src/ch375_uart_stm32.c
        )
        
        # STM32 LL drivers
        zephyr_library_include_directories(
            ${ZEPHYR_BASE}/modules/hal/stm32/stm32cube/stm32f4xx/drivers/include
            ${ZEPHYR_BASE}/modules/hal/stm32/stm32cube/stm32f4xx/soc
        )
        message(STATUS "Platform: STM32F4 (CH375 with 9-bit UART)")
        
    elseif(CONFIG_SOC_RP2350A_M33 OR CONFIG_SOC_RP2040)
        target_sources(app PRIVATE
            ${CMAKE_CURRENT_SOURCE_DIR}/drivers/ch37x/src/ch375_uart_rp2.c
        )
        
        # PIO support
        zephyr_library_include_directories(
            ${ZEPHYR_BASE}/../modules/hal/rpi_pico/src/rp2_common/hardware_pio/include
            ${ZEPHYR_BASE}/../modules/hal/rpi_pico/src/rp2_common/hardware_clocks/include
            ${ZEPHYR_BASE}/../modules/hal/rpi_pico/src/rp2_common/hardware_gpio/include
            ${ZEPHYR_BASE}/../modules/hal/rpi_pico/src/common/hardware_claim/include
            ${ZEPHYR_BASE}/../modules/hal/rpi_pico/src/rp2_common/pico_base/include
        )
        message(STATUS "Platform: ${BOARD} (CH375 with 9-bit PIO UART)")
    else()
        message(FATAL_ERROR "Unsupported platform for CH375!")
    endif()
endif()

# Common include directories
target_include_directories(app PRIVATE
    ${CMAKE_CURRENT_SOURCE_DIR}/include
    ${CMAKE_CURRENT_SOURCE_DIR}/drivers/hid/include
    ${CMAKE_CURRENT_SOURCE_DIR}/drivers/ch37x/include
)

message(STATUS "========================================")
```

## prj.conf
```kconfig
# General Configuration
CONFIG_MAIN_STACK_SIZE=4096
CONFIG_SYSTEM_WORKQUEUE_STACK_SIZE=2048
CONFIG_HEAP_MEM_POOL_SIZE=16384

# USB Device Support
CONFIG_USB_DEVICE_STACK=y
CONFIG_USB_DEVICE_HID=y
CONFIG_USB_HID_POLL_INTERVAL_MS=8
CONFIG_USB_HID_BOOT_PROTOCOL=n
CONFIG_USB_DEVICE_REMOTE_WAKEUP=y

# Multiple HID interfaces
CONFIG_USB_COMPOSITE_DEVICE=y
CONFIG_USB_HID_DEVICE_COUNT=2

# USB Device Info
CONFIG_USB_DEVICE_VID=0x1E7D
CONFIG_USB_DEVICE_PID=0x2E7C
CONFIG_USB_DEVICE_MANUFACTURER="Roccat"
CONFIG_USB_DEVICE_PRODUCT="Composite USB HID Device"

CONFIG_LOG=y
CONFIG_BOOT_BANNER=y
CONFIG_EARLY_CONSOLE=y
CONFIG_ASSERT=y

# Print float
CONFIG_CBPRINTF_FP_SUPPORT=y
CONFIG_NEWLIB_LIBC_FLOAT_PRINTF=y

CONFIG_SERIAL=y
CONFIG_PINCTRL=y
```

## src/main.c
```c
/* SPDX-License-Identifier: GPL-3.0-or-later */
/**
 * ╔═══════════════════════════════════════════════════════════════════════╗
 * ║                          GhostHIDe Project                            ║
 * ╚═══════════════════════════════════════════════════════════════════════╝
 * 
 * @file           main.c
 * @brief          Main program entry point and HID device proxy
 * 
 * @author         destrocore
 * @date           2025
 * 
 * @details
 * Main application demonstrating USB HID device enumeration, descriptor
 * parsing, and real-time input forwarding. Manages dual CH375 USB host
 * controllers for mouse and keyboard passthrough.
 * 
 * @copyright 
 * Copyright (c) 2025 akaDestrocore
 * This program is free software: you can redistribute it and/or modify
 * it under the terms of the GNU General Public License as published by
 * the Free Software Foundation, either version 3 of the License, or
 * (at your option) any later version.
 */

#include <zephyr/kernel.h>
#include <zephyr/sys/printk.h>
#include <zephyr/logging/log.h>
#include "ch37x_common.h"
#include "hid_parser.h"
#include "hid_mouse.h"
#include "usb_hid_proxy.h"
#include "hid_output.h"
#include "hid_keyboard.h"
#include "input_patterns.h"

LOG_MODULE_REGISTER(main, LOG_LEVEL_INF);

/* Defines -------------------------------------------------------------------*/
#define CH375_MODULE_COUNT 2
#define DEFAULT_REPORT_INTERVAL_MS 8
#define MAIN_LOOP_SLEEP_MS 1
#define KEYBOARD_BREAK_TIMEOUT_MS 50
#define ENUMERATION_WAIT_TIMEOUT_MS 10000
#define IFACE_MOUSE     0
#define IFACE_KEYBOARD  1

/* Type Deffinitions ---------------------------------------------------------*/
typedef struct {
    
    const char *name;
    struct gpio_dt_spec intGpio;

    ch37x_Context_t *ch37xCtx;
    struct USB_Device_t usbDev;
    struct USBHID_Device_t hidDev;
    union {
        struct HID_Mouse_t mouse;
        struct HID_Keyboard_t keyboard;
    };

    bool isConnected;
    uint8_t interfaceNum;

    uint32_t lastReportTimestampMs;
    uint32_t reportIntervalMs;
    
} DeviceInput_t;

/* Private variables ---------------------------------------------------------*/
static DeviceInput_t gDeviceInputs[CH375_MODULE_COUNT];
static struct RecoilComp_Context_t *gRecoilCompCtx = NULL;
static bool gRcEnabled;
static bool gRcActive;

static const char banner[] = 
"                                                                      \n"
" ██████  ██   ██  ██████  ███████ ████████ ██   ██ ██ ██████  ███████ \n"
"██       ██   ██ ██    ██ ██         ██    ██   ██ ██ ██   ██ ██      \n"
"██   ███ ███████ ██    ██ ███████    ██    ███████ ██ ██   ██ █████   \n"
"██    ██ ██   ██ ██    ██      ██    ██    ██   ██ ██ ██   ██ ██      \n"
" ██████  ██   ██  ██████  ███████    ██    ██   ██ ██ ██████  ███████ \n";

/* Private function prototypes -----------------------------------------------*/
static int initCh375Device(DeviceInput_t *pDevIn, const char *pName, 
                            int usartIndex, const struct gpio_dt_spec *pIntGpio, 
                            uint8_t interfaceNum);
static int openDeviceInput(DeviceInput_t *pDevIn);
static void waitAllDevicesConnect(void);
static int openAllDeviceInputs(void);
static void loopHandleDevices(void);
static int handleMouseInput(DeviceInput_t *pDevIn);
static int handleKeyboardInput(DeviceInput_t *pDevIn);
static void closeAllDevices(void);
static int initInputPatterns(void);

/**
  * @brief  The application entry point.
  * @retval int
  */
int main(void)
{
    int ret = -1;

    // Print banner
    printk("%s%s%s", "\x1b[36m", banner, "\x1b[0m");

#if defined(CONFIG_SOC_SERIES_STM32F4X)
    // // Initialize CH375 USB INT pins
    // static const struct gpio_dt_spec ch375aIntGpio = {
    //     .port = DEVICE_DT_GET(DT_NODELABEL(gpioc)),
    //     .pin = 13,
    //     .dt_flags = GPIO_ACTIVE_LOW
    // };

    // static const struct gpio_dt_spec ch375bIntGpio = {
    //     .port = DEVICE_DT_GET(DT_NODELABEL(gpioc)),
    //     .pin = 14,
    //     .dt_flags = GPIO_ACTIVE_LOW
    // };

    // const struct device *gpio_dev = DEVICE_DT_GET(DT_NODELABEL(gpioc));
    // if (!device_is_ready(gpio_dev)) {
    //     LOG_ERR("GPIO C not ready!");
    //     return -1;
    // }

#elif defined(CONFIG_SOC_RP2350A_M33) || defined(CONFIG_SOC_RP2040)

    // Verify GPIO is ready
    // const struct device *gpio_dev = DEVICE_DT_GET(DT_NODELABEL(gpio0));
    // if (!device_is_ready(gpio_dev)) {
    //     LOG_ERR("GPIO not ready!");
    //     return -1;
    // }

#else
    #error "Unsupported platform"
#endif

    // Initialize CH375 USB host controllers
    ret = initCh375Device(&gDeviceInputs[0], "CH375A", CH37X_A_USART_INDEX, NULL, IFACE_MOUSE);
    if (0 != ret) {
        return ret;
    }

    ret = initCh375Device(&gDeviceInputs[1], "CH375B", CH37X_B_USART_INDEX, NULL, IFACE_KEYBOARD);
    if (0 != ret) {
        return ret;
    }

    while (1) {
        LOG_INF("Waiting for USB devices...");
        waitAllDevicesConnect();

        LOG_INF("Enumerating devices...");
        ret = openAllDeviceInputs();
        if (ret < 0) {
            LOG_ERR("[ FAILED ] Failed to enumerate devices");
            k_msleep(1000);
            continue;
        }

        LOG_INF("Initializing recoil compensation patterns...");
        ret = initInputPatterns();
        if (ret < 0) {
            LOG_ERR("[ FAILED ] Pattern init failed: %d", ret);
            k_msleep(1000);
            continue;
        }

        LOG_INF("Initializing USB device output...");
        ret = usbhid_proxyInit();
        if (USBHID_SUCCESS != ret) {
            LOG_ERR("[ FAILED ] USB HID proxy initialization failed: %d", ret);
            recoilComp_close(gRecoilCompCtx);
            gRecoilCompCtx = NULL;
            k_msleep(1000);
            continue;
        }

        LOG_INF("Waiting for USB enumeration...");
        int enumerationAttempts = 0;
        while (true != usbhid_proxyIsReady() && enumerationAttempts < 100) {
            k_msleep(100);
            enumerationAttempts++;
        }

        if (true != usbhid_proxyIsReady()) {
            LOG_ERR("USB enumeration timeout");
            usbhid_proxyCleanup();
            closeAllDevices();
            recoilComp_close(gRecoilCompCtx);
            gRecoilCompCtx = NULL;
            k_msleep(1000);
            continue;
        }

        LOG_INF("[ OK ] USB ready - starting forwarding");
        loopHandleDevices();

        LOG_WRN("Device disconnected, restarting...");
        usbhid_proxyCleanup();
        recoilComp_close(gRecoilCompCtx);
        gRecoilCompCtx = NULL;
        closeAllDevices();
        k_msleep(1000);
    }
    
    return 0;
}

/**
 * @brief Initialize CH375 USB host controller
 * @param pDevIn Pointer to device input structure
 * @param pName Device name for logging
 * @param usartIndex Hardware USART index
 * @param pIntGpio GPIO interrupt pin specification (NULL for polling mode)
 * @param interfaceNum USB interface number (0=mouse, 1=keyboard)
 * @return 0 on success, negative error code otherwise
 */
static int initCh375Device(DeviceInput_t *pDevIn, const char *pName, int usartIndex, const struct gpio_dt_spec *pIntGpio, uint8_t interfaceNum) {
    
    int ret = -1;

    pDevIn->name = pName;
    pDevIn->interfaceNum = interfaceNum;
    
    // Store INT GPIO (NULL for polling mode)
    if (NULL != pIntGpio) {
        pDevIn->intGpio = *pIntGpio;
    } else {
        LOG_INF("%s: Running in POLLING MODE", pName);
        memset(&pDevIn->intGpio, 0, sizeof(pDevIn->intGpio));
    }
    
    pDevIn->lastReportTimestampMs = 0;
    pDevIn->reportIntervalMs = DEFAULT_REPORT_INTERVAL_MS;
    pDevIn->isConnected = false;

    ret = ch37x_hwInitManual(pName, usartIndex, pIntGpio, CH37X_DEFAULT_BAUDRATE, &pDevIn->ch37xCtx);
    if (ret < 0) {
        LOG_ERR("[ FAILED ] %s: Hardware init failed: %d", pName, ret);
        return ret;
    }

    ret = ch375_hostInit(pDevIn->ch37xCtx, CH37X_WORK_BAUDRATE);
    if (CH37X_HOST_SUCCESS != ret) {
        LOG_ERR("[ FAILED ] %s: CH375 host init failed: %d", pName, ret);
        return -EIO;
    }

    ret = ch37x_hwSetBaudrate(pDevIn->ch37xCtx, CH37X_WORK_BAUDRATE);
    if (ret < 0) {
        LOG_ERR("%s: Baudrate switch failed: %d", pName, ret);
        return ret;
    }

    LOG_INF("[ OK ] %s: Initialized successfully!", pName);
    return 0;
}

/**
 * @brief Open and enumerate USB HID device
 * @param pDevIn Device input structure
 * @return 0 on success, negative error code otherwise
 */
static int openDeviceInput(DeviceInput_t *pDevIn) {
    
    int ret = -1;

    LOG_INF("%s: Opening USB device...", pDevIn->name);

    ret = ch375_hostUdevOpen(pDevIn->ch37xCtx, &pDevIn->usbDev);
    if (CH37X_HOST_SUCCESS != ret) {
        LOG_ERR("%s: Failed to open USB device: %d", pDevIn->name, ret);
        return CH37X_HOST_ERROR;
    }

    LOG_INF("[ OK ] %s: USB device opened (VID:PID = %04X:%04X)",
            pDevIn->name, pDevIn->usbDev.vendor_id, pDevIn->usbDev.product_id);

    ret = USBHID_open(&pDevIn->usbDev, 0, &pDevIn->hidDev);
    if (USBHID_SUCCESS != ret) {
        LOG_ERR("[ FAILED ] %s: Failed to open USBHID: %d", pDevIn->name, ret);
        ch375_hostUdevClose(&pDevIn->usbDev);
        return USBHID_ERROR;
    }

    pDevIn->reportIntervalMs = DEFAULT_REPORT_INTERVAL_MS;

    if (USBHID_TYPE_MOUSE == pDevIn->hidDev.hid_type) {
        ret = hidMouse_Open(&pDevIn->hidDev, &pDevIn->mouse);
        if (USBHID_SUCCESS != ret) {
            LOG_ERR("[ FAILED ] %s: Failed to open mouse: %d", pDevIn->name, ret);
            USBHID_close(&pDevIn->hidDev);
            ch375_hostUdevClose(&pDevIn->usbDev);
            return USBHID_ERROR;
        }
        LOG_INF("[ OK ] %s: Mouse opened", pDevIn->name);
    } 
    else if (USBHID_TYPE_KEYBOARD == pDevIn->hidDev.hid_type) {
        ret = hidKeyboard_Open(&pDevIn->hidDev, &pDevIn->keyboard);
        if (USBHID_SUCCESS != ret) {
            LOG_ERR("[ FAILED ] %s: Failed to open keyboard: %d", pDevIn->name, ret);
            USBHID_close(&pDevIn->hidDev);
            ch375_hostUdevClose(&pDevIn->usbDev);
            return -1;
        }
        LOG_INF("[ OK ] %s: Keyboard opened", pDevIn->name);
    } 
    else {
        LOG_ERR("[ FAILED ] %s: Unsupported HID type: %d", pDevIn->name, pDevIn->hidDev.hid_type);
        USBHID_close(&pDevIn->hidDev);
        ch375_hostUdevClose(&pDevIn->usbDev);
        return -1;
    }

    return 0;
}

/**
 * @brief Wait for all configured USB devices to connect
 * @note Blocks until all devices are connected
 */
static void waitAllDevicesConnect(void) {
    
    int ret = -1;
    bool allConnected = false;

    while (1) {
        allConnected = true;

        for (int i = 0; i < CH375_MODULE_COUNT; i++) {
            DeviceInput_t *pDevIn = &gDeviceInputs[i];

            if (true == pDevIn->isConnected) {
                continue;
            }

            // 500ms timeout
            ret = ch375_hostWaitDeviceConnect(pDevIn->ch37xCtx, 500);
            if (CH37X_HOST_SUCCESS == ret) {
                LOG_INF("[ OK ] %s: Device connected", pDevIn->name);
                pDevIn->isConnected = true;
            } 
            else if (CH37X_HOST_ERROR == ret) {
                LOG_ERR("[ FAILED ] %s: Error waiting for device", pDevIn->name);
                allConnected = false;
            } else {
                allConnected = false;
            }
        }

        if (true == allConnected) {
            break;
        }

        k_msleep(100);
    }

    LOG_INF("[ OK ] All devices connected!");
}

/**
 * @brief Enumerate all connected USB devices
 * @return 0 on success, negative error code on failure
 */
static int openAllDeviceInputs(void) {
    
    int ret = -1;

    for (int i = 0; i < CH375_MODULE_COUNT; i++) {
        ret = openDeviceInput(&gDeviceInputs[i]);
        if (ret < 0) {
            LOG_ERR("[ FAILED ] %s: Failed to enumerate", gDeviceInputs[i].name);
            return ret;
        }
        gDeviceInputs[i].isConnected = true;
    }

    return 0;
}

/**
 * @brief Main HID input forwarding loop
 * @note Runs until device disconnection is detected
 */
static void loopHandleDevices(void) {
    
    int ret = -1;

    LOG_INF("HID processing loop started");

    while (1) {
        for (int i = 0; i < CH375_MODULE_COUNT; i++) {
            DeviceInput_t *pDevIn = &gDeviceInputs[i];

            if (true != pDevIn->isConnected) {
                continue;
            }

            if (USBHID_TYPE_MOUSE == pDevIn->hidDev.hid_type) {
                ret = handleMouseInput(pDevIn);

                if (USBHID_NO_DEV == ret) {
                    LOG_ERR("%s: Device disconnected", pDevIn->name);
                    return;
                }
            }

            else if (USBHID_TYPE_KEYBOARD == pDevIn->hidDev.hid_type) {
                ret = handleKeyboardInput(pDevIn);

                if (USBHID_NO_DEV == ret) {
                    LOG_ERR("%s: Device disconnected", pDevIn->name);
                    return;
                }
            }
        }

        k_msleep(MAIN_LOOP_SLEEP_MS);
    }
}

/**
 * @brief Handle mouse input and forward to USB output
 * @param pDevIn Device input structure
 * @return 0 on success, USBHID_NO_DEV on disconnection, negative on error
 */
static int handleMouseInput(DeviceInput_t *pDevIn) {
    
    int ret = -1;
    uint32_t buttonVal = 0;
    bool needSend = false;

    // Fetch new report from device
    ret = hidMouse_FetchReport(&pDevIn->mouse);
    if (USBHID_NO_DEV == ret) {
        LOG_ERR("%s: Device disconnected", pDevIn->name);
        return ret;
    }

    // Check LMB state
    hidMouse_GetButton(&pDevIn->mouse, HID_MOUSE_BUTTON_LEFT, &buttonVal, false);
    if (0 != buttonVal) {
        // Start/continue compensation if pressed
        if  (true != gRcActive) {
            gRcActive = true;
            recoilComp_restart(gRecoilCompCtx);
            LOG_INF("[ OK ] Recoil compensation ENABLED.");
        }

        // Get compensaton if ready
        if (true == gRcEnabled) {
            struct PatternCompensation_t compData;
            ret = recoilComp_getNextData(gRecoilCompCtx, &compData);

            if (0 == ret) {
                int32_t mouseX;
                int32_t mouseY;
                int32_t finalX;
                int32_t finalY;

                // Get actual mouse movement
                hidMouse_GetOrientation(&pDevIn->mouse, HID_MOUSE_AXIS_X, &mouseX, false);
                hidMouse_GetOrientation(&pDevIn->mouse, HID_MOUSE_AXIS_Y, &mouseY, false);

                finalX = mouseX + compData.x;
                finalY = mouseY + compData.y;

                // Apply compensation
                hidMouse_SetOrientation(&pDevIn->mouse, HID_MOUSE_AXIS_X, finalX, false);
                hidMouse_SetOrientation(&pDevIn->mouse, HID_MOUSE_AXIS_Y, finalY, false);

                needSend = true;
            } else {
                // Just forward mouse data
                needSend = (USBHID_SUCCESS == hidMouse_FetchReport(&pDevIn->mouse)) ? true : false;
            }
        } else {
            // Compensation disabled - just forward as is
            needSend = (USBHID_SUCCESS == ret) ? true : false;
        }
    } else {
        // LMB released
        if ( true == gRcActive) {
            gRcActive = false;
            LOG_INF("[ OK ] Recoil compensation DISABLED");
        }

        needSend = (USBHID_SUCCESS == ret) ? true : false;
    }

    // Send report if we have data
    if (true == needSend) {
        ret = hidOutput_sendMouseReport(&pDevIn->mouse);
        if (USBHID_SUCCESS != ret) {
            LOG_WRN("%s: Failed to send report: %d", pDevIn->name, ret);
        }
    }

    return 0;
}

/**
 * @brief Handle keyboard input and forward to USB output
 * @param pDevIn Device input structure
 * @return 0 on success, USBHID_NO_DEV on disconnection, negative on error
 */
static int handleKeyboardInput(DeviceInput_t *pDevIn) {
    
    int ret = -1;
    struct USBHID_Device_t *pHidDev;
    uint8_t *pReportBuff;
    size_t reportLen;
    uint32_t value;

    static uint8_t lastSentReport[8] = {0};
    static uint8_t lastKeyboardReport[8] = {0};

    pHidDev = pDevIn->keyboard.hid_dev;
    reportLen = pHidDev ? pHidDev->report_len : 0;

    // Fetch new report
    ret = hidKeyboard_FetchReport(&pDevIn->keyboard);

    if (USBHID_NO_DEV == ret) {
        return USBHID_NO_DEV;
    }

    // No new data
    if (USBHID_SUCCESS != ret) {
        return 0;
    }

    // Get report buffer
    ret = USBHID_getReportBuffer(pHidDev, &pReportBuff, NULL, false);
    if (USBHID_SUCCESS != ret || NULL == pReportBuff) {
        return 0;
    }

    // Skip if no chnages
    if (memcmp(pReportBuff, lastKeyboardReport, reportLen) == 0) {
        return 0;
    }

    memcpy(lastKeyboardReport, pReportBuff, reportLen);

    // Process ctrl keys
    hidKeyboard_GetKey(&pDevIn->keyboard, HID_KEY_PAGEUP, &value, false);
    if (0 != value) {
        gRcEnabled = true;
        LOG_INF("Recoil compensation profile ACTIVATED");
    }

    hidKeyboard_GetKey(&pDevIn->keyboard, HID_KEY_PAGEDOWN, &value, false);
    if (0 != value) {
        gRcEnabled = false;
        LOG_INF("Recoil compensation profile DEACTIVATED");
    }

    hidKeyboard_GetKey(&pDevIn->keyboard, HID_KBD_NUMBER('1'), &value, false);
    if (0 != value) {
        int res = recoilComp_setPreset(gRecoilCompCtx, TEMPLATE_OW2_SOLDIER76);
        if (0 == res) {
            LOG_INF("[ OK ] Selected: SOLDIER 76");
        }
    }

    hidKeyboard_GetKey(&pDevIn->keyboard, HID_KBD_NUMBER('2'), &value, false);
    if (0 != value) {
        int res = recoilComp_setPreset(gRecoilCompCtx, TEMPLATE_OW2_CASSIDY);
        if (0 == res) {
            LOG_INF("[ OK ] Selected: CASSIDY");
        }
    }

    // Coefficient adjustment
    hidKeyboard_GetKey(&pDevIn->keyboard, HID_KEY_EQUAL, &value, false);
    if (0 != value) {
        recoilComp_changeCoefficient(gRecoilCompCtx, true);
    }

    hidKeyboard_GetKey(&pDevIn->keyboard, HID_KEY_MINUS, &value, false);
    if (0 != value) {
        recoilComp_changeCoefficient(gRecoilCompCtx, false);
    }

    // Sensitivity adjustment
    hidKeyboard_GetKey(&pDevIn->keyboard, HID_KEY_COMMA, &value, false);
    if (0 != value) {
        recoilComp_changeSensitivity(gRecoilCompCtx, true);
    }

    hidKeyboard_GetKey(&pDevIn->keyboard, HID_KEY_DOT, &value, false);
    if (0 != value) {
        recoilComp_changeSensitivity(gRecoilCompCtx, false);
    }

    // Forward to USB output
    ret = usbhid_proxySendReport(pDevIn->interfaceNum, pReportBuff, reportLen);

    if (0 == ret) {
        memcpy(lastSentReport, pReportBuff, reportLen);
    } else {
        LOG_ERR("Keyboard send failed: %d", ret);
    }

    return 0;
}

/**
 * @brief Close all open USB devices and free resources
 */
static void closeAllDevices(void) {
    
    for (int i = 0; i < CH375_MODULE_COUNT; i++) {
        DeviceInput_t* pDevIn = &gDeviceInputs[i];

        if (USBHID_TYPE_MOUSE == pDevIn->hidDev.hid_type) {
            hidMouse_Close(&pDevIn->mouse);
        } 
        
        else if (USBHID_TYPE_KEYBOARD == pDevIn->hidDev.hid_type) {
            hidKeyboard_Close(&pDevIn->keyboard);
        }

        USBHID_close(&pDevIn->hidDev);
        ch375_hostUdevClose(&pDevIn->usbDev);

        pDevIn->isConnected = false;
    }
}

/**
 * @brief Initialize Recoil Compensation
 * @return 0 on success, negative error code otherwise
 */
static int initInputPatterns(void) {
    
    int ret = recoilComp_open(&gRecoilCompCtx);
    if (ret < 0) {
        LOG_ERR("[ FAILED ] Failed to open compensation pattern context: %d", ret);
        return ret;
    }

    gRcEnabled = false;
    gRcActive = false;

    LOG_INF("[ OK ] Recoil compensation pattern initialized");
    return 0;
}
```

## src/usb_hid_proxy.c
```c
/* SPDX-License-Identifier: GPL-3.0-or-later */
/**
 * ╔═══════════════════════════════════════════════════════════════════════╗
 * ║                          GhostHIDe Project                            ║
 * ╚═══════════════════════════════════════════════════════════════════════╝
 * 
 * @file           usb_hid_proxy.h
 * @brief          USB HID proxy implementation
 * 
 * @author         destrocore
 * @date           2025
 * 
 * @details
 * This module uses Zephyr's legacy USB device stack (usb_device.h, usb/class/usb_hid.h)
 * which is marked as @deprecated in favor of the new USBD stack (usbd.h, usbd_hid.h).
 * 
 * The legacy stack is intentionally retained because:
 *  1. Dynamic reconnection: This application requires USB re-initialization after
 *     device disconnection/reconnection cycles. The new USBD stack does not support
 *     calling usbd_init() multiple times (returns -EALREADY on subsequent calls).
 * 
 *  2. Simplified lifecycle: The legacy stack's usb_enable()/usb_disable() pattern
 *     works seamlessly with hot-plug scenarios, while USBD requires persistent
 *     initialization and complex state management across reconnection events.
 * 
 *  3. Minimal devicetree overhead: USBD requires extensive devicetree configuration
 *     for composite devices, while the legacy stack handles this programmatically.
 *
 * Migration to USBD would require architectural
 * changes incompatible with the dynamic device proxy model.
 * 
 * @copyright 
 * Copyright (c) 2025 akaDestrocore
 * This program is free software: you can redistribute it and/or modify
 * it under the terms of the GNU General Public License as published by
 * the Free Software Foundation, either version 3 of the License, or
 * (at your option) any later version.
 */

#include "usb_hid_proxy.h"

LOG_MODULE_REGISTER(usb_hid_proxy, LOG_LEVEL_INF);

/* Private function prototypes -----------------------------------------------*/
static void mouse_int_in_ready(const struct device *pDev);
static void kbd_int_in_ready(const struct device *pDev);
void usb_status_cb(enum usb_dc_status_code status, const uint8_t *pParam);

/* Private variables ---------------------------------------------------------*/
static const struct device *pHidDevMouse = NULL;
static const struct device *pHidDevKbd = NULL;
static K_SEM_DEFINE(mouseSem, 1, 1);
static K_SEM_DEFINE(kbdSem, 1, 1);
static volatile enum usb_dc_status_code gUsbStatus = USB_DC_UNKNOWN;
static volatile bool isUsbConfigured = false;
static const struct hid_ops mouseOps = {
    .int_in_ready = mouse_int_in_ready,
};

static const struct hid_ops kbdOps = {
    .int_in_ready = kbd_int_in_ready,
};

/**
 * @brief Generic HID Mouse Report Descriptor
 */
static const uint8_t hidMouseReportDesc[] = {
    0x05, 0x01,        // Usage Page (Generic Desktop)
    0x09, 0x02,        // Usage (Mouse)
    0xA1, 0x01,        // Collection (Application)

    0x05, 0x09,        //    Usage Page (Buttons)
    0x19, 0x01,        //    Usage Minimum (Button 1)
    0x29, 0x08,        //    Usage Maximum (Button 8)
    0x15, 0x00,        //    Logical Minimum (0)
    0x25, 0x01,        //    Logical Maximum (1)
    0x95, 0x08,        //    Report Count (8)
    0x75, 0x01,        //    Report Size (1 bit)
    0x81, 0x02,        //    Input (Data, Variable, Absolute)

    0x05, 0x01,        //    Usage Page (Generic Desktop)
    0x09, 0x30,        //    Usage (X)
    0x09, 0x31,        //    Usage (Y)
    0x16, 0x00, 0x80,  //    Logical Minimum (-32768)
    0x26, 0xFF, 0x7F,  //    Logical Maximum (32767)
    0x75, 0x10,        //    Report Size (16 bits)
    0x95, 0x02,        //    Report Count (2)
    0x81, 0x06,        //    Input (Data, Variable, Relative)

    0x09, 0x38,        //    Usage (Wheel)
    0x15, 0x81,        //    Logical Minimum (-127)
    0x25, 0x7F,        //    Logical Maximum (127)
    0x75, 0x08,        //    Report Size (8 bits)
    0x95, 0x01,        //    Report Count (1)
    0x81, 0x06,        //    Input (Data, Variable, Relative)

    0xC0               // End Collection
};

static const uint8_t hidKbdReportDesc[] = {
    0x05, 0x01,        // Usage Page (Generic Desktop)
    0x09, 0x06,        // Usage (Keyboard)
    0xA1, 0x01,        // Collection (Application)
    0x05, 0x07,        //   Usage Page (Key Codes)
    0x19, 0xE0,        //   Usage Minimum (224)
    0x29, 0xE7,        //   Usage Maximum (231)
    0x15, 0x00,        //   Logical Minimum (0)
    0x25, 0x01,        //   Logical Maximum (1)
    0x75, 0x01,        //   Report Size (1)
    0x95, 0x08,        //   Report Count (8)
    0x81, 0x02,        //   Input (Data, Variable, Absolute)
    0x95, 0x01,        //   Report Count (1)
    0x75, 0x08,        //   Report Size (8)
    0x81, 0x01,        //   Input (Constant)
    0x95, 0x06,        //   Report Count (6)
    0x75, 0x08,        //   Report Size (8)
    0x15, 0x00,        //   Logical Minimum (0)
    0x25, 0x65,        //   Logical Maximum (101)
    0x05, 0x07,        //   Usage Page (Key Codes)
    0x19, 0x00,        //   Usage Minimum (0)
    0x29, 0x65,        //   Usage Maximum (101)
    0x81, 0x00,        //   Input (Data, Array)
    0xC0               // End Collection
};

/**
 * @brief Generic HID Keyboard Report Descriptor
 */

/* --------------------------------------------------------------------------
 * Public API
 * -------------------------------------------------------------------------*/

/**
  * @brief Initialize USB HID devices
  * @retval 0 on success, error code otherwise
  */
int usbhid_proxyInit(void) {
    
    int ret = -1;

    // Reset first
    isUsbConfigured = false;
    gUsbStatus = USB_DC_UNKNOWN;


    // Get bindings for both devices
    pHidDevMouse = device_get_binding("HID_0");
    if (NULL == pHidDevMouse) {
        LOG_ERR("HID_0 device not found");
        return -ENODEV;
    }

    pHidDevKbd = device_get_binding("HID_1");
    if (NULL == pHidDevKbd) {
        LOG_ERR("HID_1 device not found");
        return -ENODEV;
    }

    // Register descriptors
    usb_hid_register_device(pHidDevMouse, hidMouseReportDesc, sizeof(hidMouseReportDesc), &mouseOps);
    LOG_INF("Mouse descriptor registered (HID_0)");
    usb_hid_register_device(pHidDevKbd, hidKbdReportDesc, sizeof(hidKbdReportDesc), &kbdOps);
    LOG_INF("Keyboard descriptor registered (HID_1)");

    // Initialize each HID device
    ret = usb_hid_init(pHidDevMouse);
    if (0 != ret) {
        LOG_ERR("Failed to initialize HID device: %d", ret);
        return -ENODEV;
    }

    ret = usb_hid_init(pHidDevKbd);
    if (0 != ret) {
        LOG_ERR("Failed to initialize HID device: %d", ret);
        return -ENODEV;
    }

    // Enable USB
    ret = usb_enable(usb_status_cb);
    if (0 != ret) {
        LOG_ERR("Failed to enable USB: %d", ret);
        return ret;
    }

    LOG_INF("Waiting for enumeration.");

    return 0;
}

/**
 * @brief Check if the HID device is ready to be used
 * @return USB status
 */
bool usbhid_proxyIsReady(void)
{
    return isUsbConfigured;
}

/**
 * @brief Send report ot endpoint
 * @param ifaceNum interface number
 * @param pReport pointer to the report descriptor
 * @param len size of the report descriptor
 * @return 0 on success, error code otherwise
 */
int usbhid_proxySendReport(uint8_t ifaceNum, uint8_t *pReport, size_t len) {
    
    int ret = -1;
    static uint32_t sendCount[2] = {0,0};
    const struct device *pDev;
    struct k_sem *semaphore;

    if (NULL == pReport || 0 == len) {
        return -EINVAL;
    }
    
    if (true != isUsbConfigured) {
        static uint32_t not_ready_count = 0;
        if (++not_ready_count % 100 == 0) {
            LOG_WRN("USB not configured (%" PRIu32 " times)", not_ready_count);
        }
        return -EAGAIN;
    }
    
    if (0 == ifaceNum) {
        pDev = pHidDevMouse;
        semaphore = &mouseSem;
    }
    else if (1 == ifaceNum) {
        pDev = pHidDevKbd;
        semaphore = &kbdSem;
    } else {
        return -EINVAL;
    }

    if (NULL == pDev) {
        return -ENODEV;
    }
    
    sendCount[ifaceNum]++;
    
    // Wait for EP to be ready
    if (0 != k_sem_take(semaphore, K_MSEC(100))) {
        static uint32_t busyCount[2] = {0, 0};
        if (++busyCount[ifaceNum] % 50 == 0) {
            LOG_WRN("Interface %d: Semaphore busy (%" PRIu32 " times)", ifaceNum, busyCount[ifaceNum]);
        }
        return -EBUSY;
    }
    
    // Write report
    ret = hid_int_ep_write(pDev, pReport, len, NULL);
    
    if (0 != ret) {
        // Give semaphore back on failure
        k_sem_give(semaphore);
        
        static uint32_t writeFailCount[2] = {0, 0};
        if (++writeFailCount[ifaceNum] % 50 == 0) {
            LOG_ERR("Interface %d: Write failed %" PRIu32 " times (last ret=%d)", ifaceNum, writeFailCount[ifaceNum], ret);
        }
        
        return ret;
    }
    
    // Sample successful sends
    if (sendCount[ifaceNum] % 100 == 0) {
        LOG_DBG("Interface %d: Send #%" PRIu32 " successful", ifaceNum, sendCount[ifaceNum]);
    }
    
    return 0;
}

/**
 * @brief Send report ot endpoint
 * @return 0 on success, error code otherwise
 */
void usbhid_proxyCleanup(void) {
    
    usb_disable();
    isUsbConfigured = false;
    pHidDevMouse = NULL;
    pHidDevKbd = NULL;
    
    // Reset semaphore
    k_sem_reset(&mouseSem);
    k_sem_give(&mouseSem);
    k_sem_reset(&kbdSem);
    k_sem_give(&kbdSem);
}

/* --------------------------------------------------------------------------
 * HELPER FUNCTIONS
 * -------------------------------------------------------------------------*/
static void mouse_int_in_ready(const struct device *pDev) {
    
    (void)(pDev);
    k_sem_give(&mouseSem);
    LOG_DBG("Mouse endpoint ready");
}

static void kbd_int_in_ready(const struct device *pDev) {
    
    (void)(pDev);
    k_sem_give(&kbdSem);
    LOG_DBG("Keyboard endpoint ready");
}

void usb_status_cb(enum usb_dc_status_code status, const uint8_t *pParam) {
    
    (void)(pParam);
    gUsbStatus = status;
    
    LOG_INF("USB Status Change: 0x%02X", status);
    
    switch (status) {
        case USB_DC_ERROR: {
            LOG_ERR("USB_DC_ERROR");
            isUsbConfigured = false;
            break;
        }
            
        case USB_DC_RESET: {
            LOG_INF("USB_DC_RESET - device being reset");
            isUsbConfigured = false;
            break;
        }
            
        case USB_DC_CONNECTED: {
            LOG_INF("USB_DC_CONNECTED - cable connected");
            break;
        }
            
        case USB_DC_CONFIGURED: {
            isUsbConfigured = true;
            LOG_INF("USB_DC_CONFIGURED - ready for writes!");
            break;
        }
            
        case USB_DC_DISCONNECTED: {
            isUsbConfigured = false;
            LOG_WRN("USB_DC_DISCONNECTED");
            break;
        }
            
        case USB_DC_SUSPEND: {
            LOG_INF("USB_DC_SUSPEND");
            break;
        }
            
        case USB_DC_RESUME: {
            isUsbConfigured = true;
            LOG_INF("USB_DC_RESUME");
            break;
        }
            
        case USB_DC_INTERFACE: {
            LOG_DBG("USB_DC_INTERFACE");
            break;
        }
            
        case USB_DC_SET_HALT: {
            LOG_DBG("USB_DC_SET_HALT");
            break;
        }
            
        case USB_DC_CLEAR_HALT: {
            LOG_DBG("USB_DC_CLEAR_HALT");
            break;
        }
            
        case USB_DC_SOF: {
            // LOG_DBG("USB_DC_SOF");
            break;
        }
            
        case USB_DC_UNKNOWN:
        default: {
            LOG_WRN("USB_DC_UNKNOWN: 0x%02X", status);
            break;
        }
    }
}
```
